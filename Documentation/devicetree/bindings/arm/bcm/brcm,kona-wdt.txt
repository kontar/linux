## Documentation/devicetree/bindings/arm/bcm/brcm,kona-wdt.txt
```
Broadcom Kona Family Watchdog Timer
-----------------------------------

This watchdog timer is used in the following Broadcom SoCs:
  BCM11130, BCM11140, BCM11351, BCM28145, BCM28155

Required properties:
  - compatible = "brcm,kona-wdt";
  - reg: memory range

Example:
	watchdog@35002f40 {
		compatible = "brcm,kona-wdt";
		reg = <0x35002f40 0x6c>;
	};
```

## Documentation/devicetree/bindings/gpio/gpio-bcm-kona.txt
```
Broadcom Kona Family GPIO
-------------------------

This GPIO driver is used in the following Broadcom SoCs:
  BCM11130, BCM11140, BCM11351, BCM28145, BCM28155

The GPIO controller only supports edge, not level triggering.

Required properties:
  - compatible: "brcm,kona-gpio"
  - reg: Physical base address and length of the controller's registers.
  - interrupts: The interrupt outputs from the controller.
  - #gpio-cells: Should be <2>. The first cell is the pin number, the second
    cell is used to specify optional parameters:
    - bit 0 specifies polarity (0 for normal, 1 for inverted)
  - #interrupt-cells: Should be <2>. The first cell is the GPIO number.
    The second cell is used to specify flags:
    - trigger type (bits[1:0]):
        1 = low-to-high edge triggered.
        2 = high-to-low edge triggered.
        3 = low-to-high or high-to-low edge triggered
        Valid values are 1, 2, 3
  - gpio-controller: Marks the device node as a GPIO controller.
  - interrupt-controller: Marks the device node as an interrupt controller.

Example:
	gpio: gpio@35003000 {
		compatible = "brcm,kona-gpio";
		reg = <0x35003000 0x800>;
		interrupts =
		       <0x0 106 0x4
			0x0 115 0x4
			0x0 114 0x4
			0x0 113 0x4
			0x0 112 0x4
			0x0 111 0x4>;
		#gpio-cells = <2>;
		#interrupt-cells = <2>;
		gpio-controller;
		interrupt-controller;
	};
```

## Documentation/devicetree/bindings/hwqueue/keystone-hwqueue.txt
```
* Texas Instruments Keystone hwqueue driver

Required properties:
- compatible : Should be  "ti,keystone-hwqueue";
- reg : Address and length of the register set for the device for peek,
	push/pop etc.
- range		: <start number> total range of hwqueue numbers for the device
- region	: <start number> of memory regions to use
- linkram0	: <start number> of total link ram indices available
- link-index	: <start number> of link ram indices to use
- queues	: number of queues to use per queue range name (see example below)
- descriptors	: number and size of descriptors to use per hwqueue instance
		   name (see example below)

Optional properties:
- pdsps - PDSP configuration, if any.

Example:

hwqueue0: hwqueue@2a00000 {
	compatible = "ti,keystone-hwqueue";
	#address-cells = <1>;
	#size-cells = <1>;
	ranges;
	reg = <0x2a00000 0x20000	/* 0 - peek	*/
	       0x2a62000 0x6000		/* 1 - status	*/
	       0x2a68000 0x2000		/* 2 - config	*/
	       0x2a6a000 0x4000		/* 3 - region	*/
	       0x2a20000 0x20000>;	/* 4 - push/pop	*/
	range		= <0 0x1000>;
	regions		= <12 3>;
	linkram0	= <0x80000 0x4000>;
	link-index	= <0x800 0x400>;
	queues {
		pacmd {
			values = <640 1>;
			reserved;
		};
		patx {
			values = <648 1>;
			reserved;
		};
		qpend-arm {
			values = <650 8>;
			irq-base = <41>;
		};
		infradma {
			values = <800 2>;
			reserved;
		};
		general {
			values = <4000 16>;
		};
	};
	descriptors {
		pool-veth {
			values = <256 128>;	/* num_desc desc_size */
		};
		pool-net {
			values = <512 128>;	/* num_desc desc_size */
		};
	};
	pdsps {
		#address-cells = <1>;
		#size-cells = <1>;
		ranges;
		pdsp0@0x2a60000 {
			firmware = "keystone/qmss_pdsp_acc48_le_1_0_2_0.fw";
			reg = <0x2a60000 0x1000    /*iram */
			       0x2a6e000 0x1000    /*reg*/
			       0x2ab8000 0x4000>;  /*cmd*/
		};
	};
};
```

## Documentation/devicetree/bindings/i2c/i2c-bcm-kona.txt
```
Broadcom Kona Family I2C
=========================

This I2C controller is used in the following Broadcom SoCs:

  BCM11130
  BCM11140
  BCM11351
  BCM28145
  BCM28155

Required Properties
-------------------
- compatible: "brcm,bcm11351-i2c", "brcm,kona-i2c"
- reg: Physical base address and length of controller registers
- interrupts: The interrupt number used by the controller
- clock-frequency: The I2C bus frequency in Hz
- #address-cells: Should be <1>
- #size-cells: Should be <0>

Example:

i2c@3e016000 {
	compatible = "brcm,bcm11351-i2c","brcm,kona-i2c";
	reg = <0x3e016000 0x80>;
	interrupts = <GIC_SPI 103 IRQ_TYPE_LEVEL_HIGH>;
	clock-frequency = <400000>;
	#address-cells = <1>;
	#size-cells = <0>;
};
```

## Documentation/devicetree/bindings/net/davinci_mdio.txt
```
MDIO on DaVinci SOCs

Currently defined compatibles:
- ti,davinci_mdio

Required properties:
- bus-freq: The operating frequency of the mdio bus

Example:

mdio: mdio@2090300 {
			compatible	= "ti,davinci_mdio";
			reg		= <0x2090300 0x100>;
			bus-freq	= <50000000>;
		};
```

## Documentation/devicetree/bindings/net/keystone-net.txt
```
This document describes the device tree bindings associated with the
keystone network driver support.

tx_channel: the packet dma channel name associated with tx
rx_channel: the packet dma channel name associated with rx
reg:        the regsiter start address and the szie that will be
            used by the driver.

Below we provide 2 examples.

veth: veth@2a6c000 {
	compatible = "ti,keystone-veth";
	tx_channel = "vethtx";
	rx_channel = "vethrx";
};

netcp: netcp@2090000 {
	reg = <0x2090000 0xf00>;
	compatible = "ti,keystone-netcp";
	tx_channel = "nettx";
	rx_channel = "netrx";
};
```

## Documentation/devicetree/bindings/remoteproc/keystone-remoteproc.txt
```
* Texas Instruments Keystone remoteproc driver

Required properties:
 - compatible :	Should be "ti,keystone-rproc".
 - reg :	This property defines the address and length of the
		registers used to reset, start and interrupt a DSP core.
 - addr-map:	This property defines the memory address map used by the rproc device
		to download and boot a DSP firmware image.
		Each tuple consists of a DSP core's
		global address, local address and size.
 - core :	Name of this remote processor device.
 - firmware :	Name of DSP firmware image to load.
 - core-dump-mask: Mask which is used to identify which DSP core has crashed.

Example:
rproc0: rproc@2620040 {
			compatible = "ti,keystone-rproc";
			reg = <0x02620040 4				/* boot address register */
			       0x02350A5C 4				/* module control register */
			       0x02350120 4				/* power domain transition command register */
			       0x02620240 4				/* ipc interrupt generation register */
			       0x026202BC 4>;				/* ipc arch register */
			addr-map = <0x10800000 0x00800000 0x100000	/* l2-ram  global, local, size */
				    0x0c000000 0x0c000000 0x200000	/* msmc-sram  global, local, size */
				    0xa0000000 0xa0000000 0x20000000>;	/* ddr3-sram  global, local, size */
			core = "dsp-core0";
			firmware = "dsp-core0.out";
			core-dump-mask	= <0x00000010>;			/* ipc arch register mask */
		};
```

## Documentation/devicetree/bindings/staging/dwc2.txt
```
Platform DesignWare HS OTG USB 2.0 controller
-----------------------------------------------------

Required properties:
- compatible : "snps,dwc2"
- reg : Should contain 1 register range (address and length)
- interrupts : Should contain 1 interrupt

Optional properties:
- snps,phy-utmi-width: Must contain the UTMI data width (either 8 or 16)

Example:

        usb@101c0000 {
                compatible = "ralink,rt3050-usb, snps,dwc2";
                reg = <0x101c0000 40000>;
                interrupts = <18>;
		snps,phy-utmi-width = <8>;
        };
```

## Documentation/devicetree/bindings/thermal/bcm-kona-thermal.txt
```
* Broadcom Kona Thermal Management Unit

This version is for the BCM281xx family of SoCs.

Required properties:
- compatible : "brcm,bcm11351-thermal", "brcm,kona-thermal"
- reg : Address range of the thermal register
- thermal-name: this entry must be specified and it will be passed into
thermal_zone_device_register().  This name will also be reported under Hwmon
sysfs 'name' attribute.

Example:
	thermal@34008000 {
		compatible = "brcm,bcm11351-thermal", "brcm,kona-thermal";
		reg = <0x34008000 0x0024>;
		thermal-name = "bcm_kona_therm";
		status = "disabled";
	};
```

## Documentation/devicetree/bindings/usb/bcm-kona-usb-ctrl.txt
```
BROADCOM KONA USB CONTROL

Required properties:
 - compatible: brcm,kona-ctrl-usb
 - reg: offset and length of the USB control registers

Example:

	usbctl: usbctl@3f130000 {
		compatible = "brcm,kona-ctrl-usb";
		reg = <0x3f130000 0x28>;
	};
```

## Documentation/devicetree/bindings/usb/bcm-kona-usb-phy.txt
```
BROADCOM KONA USB PHY

Required properties:
 - compatible: brcm,kona-usb2

Example:

	usbphy: usbphy {
		compatible = "brcm,kona-usb2";
	};
```

## arch/arm/configs/keystone_defconfig
```kconfig
CONFIG_EXPERIMENTAL=y
CONFIG_BLK_DEV_INITRD=y
CONFIG_ARCH_KEYSTONE=y
CONFIG_ARM_LPAE=y
CONFIG_SMP=y
CONFIG_ARM_ARCH_TIMER=y
CONFIG_NR_CPUS=4
CONFIG_AEABI=y
CONFIG_HIGHMEM=y
CONFIG_VFP=y
CONFIG_NEON=y
# CONFIG_SUSPEND is not set
CONFIG_NET=y
CONFIG_PACKET=y
CONFIG_UNIX=y
CONFIG_UNIX_DIAG=y
CONFIG_XFRM_SUB_POLICY=y
CONFIG_XFRM_STATISTICS=y
CONFIG_NET_KEY=y
CONFIG_NET_KEY_MIGRATE=y
CONFIG_INET=y
CONFIG_IP_MULTICAST=y
CONFIG_IP_ADVANCED_ROUTER=y
CONFIG_IP_MULTIPLE_TABLES=y
CONFIG_IP_ROUTE_MULTIPATH=y
CONFIG_IP_ROUTE_VERBOSE=y
CONFIG_IP_PNP=y
CONFIG_IP_PNP_DHCP=y
CONFIG_IP_PNP_BOOTP=y
CONFIG_NET_IPIP=y
CONFIG_NET_IPGRE_DEMUX=y
CONFIG_NET_IPGRE=y
CONFIG_IP_MROUTE=y
CONFIG_IP_MROUTE_MULTIPLE_TABLES=y
CONFIG_IP_PIMSM_V2=y
CONFIG_INET_AH=y
CONFIG_INET_IPCOMP=y
CONFIG_IP_SCTP=y
CONFIG_VLAN_8021Q=y
CONFIG_UEVENT_HELPER_PATH="/sbin/hotplug"
CONFIG_BLK_DEV_RAM=y
CONFIG_NETDEVICES=y
CONFIG_TI_DAVINCI_MDIO=y
CONFIG_MARVELL_PHY=y
CONFIG_SERIAL_8250=y
CONFIG_SERIAL_8250_CONSOLE=y
CONFIG_SERIAL_OF_PLATFORM=y
CONFIG_DMADEVICES=y
CONFIG_SPI=y
CONFIG_SPI_DAVINCI=y
CONFIG_SPI_SPIDEV=y
CONFIG_PRINTK_TIME=y
CONFIG_DEBUG_KERNEL=y
CONFIG_DEBUG_INFO=y
CONFIG_DEBUG_USER=y
CONFIG_DEBUG_LL=y
CONFIG_EARLY_PRINTK=y
CONFIG_COMMON_CLK_DEBUG=y
CONFIG_MTD=y
CONFIG_MTD_CMDLINE_PARTS=y
CONFIG_MTD_CHAR=y
CONFIG_MTD_BLOCK=y
CONFIG_MTD_PLATRAM=y
CONFIG_MTD_M25P80=y
CONFIG_MTD_NAND=y
CONFIG_MEMORY=y
CONFIG_MTD_NAND_DAVINCI=y
```

## arch/arm/configs/tci6614_evm_nocache_defconfig
```kconfig
CONFIG_EXPERIMENTAL=y
# CONFIG_SWAP is not set
CONFIG_LOG_BUF_SHIFT=14
CONFIG_BLK_DEV_INITRD=y
CONFIG_CC_OPTIMIZE_FOR_SIZE=y
CONFIG_SYSCTL_SYSCALL=y
CONFIG_KALLSYMS_ALL=y
# CONFIG_ELF_CORE is not set
# CONFIG_BASE_FULL is not set
CONFIG_EMBEDDED=y
CONFIG_PROFILING=y
CONFIG_OPROFILE=y
CONFIG_KPROBES=y
CONFIG_MODULES=y
CONFIG_MODULE_FORCE_LOAD=y
CONFIG_MODULE_UNLOAD=y
CONFIG_MODULE_FORCE_UNLOAD=y
CONFIG_MODVERSIONS=y
CONFIG_ARCH_DAVINCI=y
CONFIG_ARCH_DAVINCI_TCI6614=y
CONFIG_MACH_TCI6614_EVM=y
# CONFIG_DAVINCI_MUX is not set
CONFIG_CPU_ICACHE_DISABLE=y
CONFIG_CPU_DCACHE_DISABLE=y
CONFIG_PREEMPT=y
CONFIG_AEABI=y
CONFIG_FPE_NWFPE=y
CONFIG_VFP=y
CONFIG_NEON=y
# CONFIG_SUSPEND is not set
CONFIG_NET=y
CONFIG_PACKET=y
CONFIG_UNIX=y
CONFIG_INET=y
CONFIG_IP_PNP=y
CONFIG_IP_PNP_DHCP=y
CONFIG_IP_PNP_BOOTP=y
CONFIG_UEVENT_HELPER_PATH="/sbin/hotplug"
CONFIG_DEBUG_DRIVER=y
CONFIG_MTD=y
CONFIG_MTD_CMDLINE_PARTS=y
CONFIG_MTD_CHAR=y
CONFIG_MTD_BLOCK=y
CONFIG_MTD_PLATRAM=y
CONFIG_MTD_M25P80=y
CONFIG_MTD_NAND=y
CONFIG_MTD_NAND_DAVINCI=y
CONFIG_MTD_UBI=y
CONFIG_PROC_DEVICETREE=y
CONFIG_BLK_DEV_LOOP=y
CONFIG_EEPROM_AT24=y
CONFIG_NETDEVICES=y
CONFIG_TI_DAVINCI_MDIO=y
CONFIG_MARVELL_PHY=y
# CONFIG_INPUT_MOUSEDEV is not set
# CONFIG_INPUT_KEYBOARD is not set
# CONFIG_INPUT_MOUSE is not set
# CONFIG_VT is not set
# CONFIG_LEGACY_PTYS is not set
CONFIG_SERIAL_8250=y
CONFIG_SERIAL_8250_CONSOLE=y
CONFIG_SERIAL_8250_NR_UARTS=3
CONFIG_SERIAL_8250_RUNTIME_UARTS=3
# CONFIG_HW_RANDOM is not set
CONFIG_I2C=y
# CONFIG_I2C_COMPAT is not set
CONFIG_I2C_DAVINCI=y
CONFIG_SPI=y
CONFIG_SPI_DAVINCI=y
CONFIG_SPI_SPIDEV=y
CONFIG_GPIO_SYSFS=y
# CONFIG_HWMON is not set
CONFIG_WATCHDOG=y
CONFIG_DAVINCI_WATCHDOG=y
# CONFIG_HID_SUPPORT is not set
# CONFIG_USB_SUPPORT is not set
CONFIG_DMADEVICES=y
CONFIG_TMPFS=y
CONFIG_JFFS2_FS=y
CONFIG_JFFS2_FS_WBUF_VERIFY=y
CONFIG_UBIFS_FS=y
CONFIG_CRAMFS=y
CONFIG_NFS_FS=y
CONFIG_NFS_V3=y
CONFIG_NFS_V3_ACL=y
CONFIG_ROOT_NFS=y
CONFIG_NFSD=y
CONFIG_NFSD_V3=y
CONFIG_NFSD_V3_ACL=y
CONFIG_DEBUG_SHIRQ=y
CONFIG_DEBUG_INFO=y
```

## arch/arm/configs/tci6614_sim_defconfig
```kconfig
CONFIG_EXPERIMENTAL=y
# CONFIG_SWAP is not set
CONFIG_LOG_BUF_SHIFT=14
CONFIG_BLK_DEV_INITRD=y
CONFIG_CC_OPTIMIZE_FOR_SIZE=y
CONFIG_SYSCTL_SYSCALL=y
CONFIG_KALLSYMS_ALL=y
# CONFIG_ELF_CORE is not set
# CONFIG_BASE_FULL is not set
CONFIG_EMBEDDED=y
CONFIG_KPROBES=y
CONFIG_MODULES=y
CONFIG_MODULE_FORCE_LOAD=y
CONFIG_MODULE_UNLOAD=y
CONFIG_MODULE_FORCE_UNLOAD=y
CONFIG_MODVERSIONS=y
CONFIG_ARCH_DAVINCI=y
CONFIG_ARCH_DAVINCI_TCI6614=y
CONFIG_MACH_TCI6614_SIM=y
# CONFIG_DAVINCI_MUX is not set
CONFIG_PREEMPT=y
CONFIG_AEABI=y
# CONFIG_SUSPEND is not set
CONFIG_NET=y
CONFIG_UNIX=y
CONFIG_UEVENT_HELPER_PATH="/sbin/hotplug"
CONFIG_DEBUG_DRIVER=y
# CONFIG_INPUT_MOUSEDEV is not set
# CONFIG_INPUT_KEYBOARD is not set
# CONFIG_INPUT_MOUSE is not set
# CONFIG_VT is not set
# CONFIG_LEGACY_PTYS is not set
CONFIG_SERIAL_8250=y
CONFIG_SERIAL_8250_CONSOLE=y
CONFIG_SERIAL_8250_NR_UARTS=3
CONFIG_SERIAL_8250_RUNTIME_UARTS=3
# CONFIG_HW_RANDOM is not set
# CONFIG_HWMON is not set
CONFIG_WATCHDOG=y
CONFIG_DAVINCI_WATCHDOG=y
# CONFIG_HID_SUPPORT is not set
# CONFIG_USB_SUPPORT is not set
CONFIG_TMPFS=y
CONFIG_CRAMFS=y
CONFIG_DEBUG_SHIRQ=y
CONFIG_DEBUG_INFO=y
CONFIG_DEBUG_LL=y
CONFIG_EARLY_PRINTK=y
CONFIG_COMMON_CLK_DEBUG=y
CONFIG_DEBUG_DAVINCI_TCI6614_UART0=y
```

## drivers/hwqueue/Kconfig
```kconfig
#
# Generic HWQUEUE framework
#

# HWQUEUE always gets selected by whoever wants it.
config HWQUEUE
	tristate

menu "Hardware Queue drivers"

config HWQUEUE_KEYSTONE
	tristate "Keystone Hardware Queue device"
	depends on TI_KEYSTONE
	default y if TI_KEYSTONE
	select HWQUEUE
	help
	  Say y here to support the Keystone Hardware queue device

	  If unsure, say N.

endmenu
```

## drivers/remoteproc/Kconfig
```kconfig
# REMOTEPROC gets selected by whoever wants it
config REMOTEPROC
	tristate

config OMAP_REMOTEPROC
	tristate "OMAP remoteproc support"
	depends on ARCH_OMAP4
	select OMAP_IOMMU
	select REMOTEPROC
	select OMAP_MBOX_FWK
	select RPMSG
	default m
	help
	  Say y here to support OMAP's remote processors (dual M3
	  and DSP on OMAP4) via the remote processor framework.

	  Usually you want to say y here, in order to enable multimedia
	  use-cases to run on your platform (multimedia codecs are
	  offloaded to remote DSP processors using this framework).

	  It's safe to say n here if you're not interested in multimedia
	  offloading or just want a bare minimum kernel.

config KEYSTONE_REMOTEPROC
	tristate "Keystone remoteproc support"
	depends on TI_KEYSTONE
	select REMOTEPROC
	default y
	help
	  Say y here to support remote processors (C66x DSPs) on the Keystone
	  architecture, via the remote processor framework.

	  Usually you want to say y here, in order to load up and manage
	  remote DSP devices on your platform.

	  It's safe to say n here if you're not interested in remote DSP
	  management, or if you want a minimal kernel build.
```
