/dts-v1/;
/include/ "skeleton.dtsi"

/ {
	model = "Texas Instruments Keystone 2 SoC";
	compatible = "ti,keystone-evm";
	#address-cells = <1>;
	#size-cells = <1>;

	chosen {
		bootargs = "console=ttyS0,115200n8 root=/dev/mtdblock3 rw rootfstype=jffs2 ip=dhcp";
	};

	memory {
		device_type = "memory";
		reg = <0x80000000 0x8000000>;
	};

	cpus {
		cpu@0 {
			compatible = "arm,cortex-a15";
			reg = <0>;

			timer@xxxxxxxx {
				compatible = "arm,armv7-timer";
				clock-frequency = <500>; /* optional */
				irq = <x x>
			};
		};
	};

	soc@2000000 {
		#address-cells = <1>;
		#size-cells = <1>;
		device_type = "simple-bus";
		compatible = "ti,keystone";
		ranges;

		intc: interrupt-controller@xxxxxxxx {
			compatible = "arm,cortex-a15-gic";
			#interrupt-cells = <3>;
			#size-cells = <0>;
			#address-cells = <1>;
			interrupt-controller;
			interrupt-parent;
			reg = <0xfff11000 0x1000>,
			      <0xfff10100 0x100>;
		};
	};
};
